## ncs/west.yml
```yaml
# Example application-specific west.yml, using manifest imports.
manifest:
  remotes:
    - name: ncs
      url-base: https://github.com/nrfconnect
  projects:
    - name: nrf
      remote: ncs
      revision: v1.4.2
      import: true
  self:
    path: application
```

## west.yml
```yaml
# Example application-specific west.yml, using manifest imports.
manifest:
  remotes:
    - name: ncs
      url-base: https://github.com/nrfconnect
    - name: gtest
      url-base: https://github.com/google
  projects:
    - name: sdk-nrf
      path: nrf
      remote: ncs
      revision: v1.5.0
      import: 
        path-prefix: work/ncs
    - name: googletest
      path: work/ext/gtest
      remote: gtest
      revision: release-1.10.0
  self:
    path: app
```
